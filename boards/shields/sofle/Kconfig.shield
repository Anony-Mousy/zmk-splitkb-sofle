## boards/shields/sofle/Kconfig.shield
```kconfig
# Copyright (c) 2020 Ryan Cross
# SPDX-License-Identifier: MIT

# No whitespace after the comma or in the keyboard name!
config SHIELD_SOFLE_DONGLE
    def_bool $(shields_list_contains,my_sofle_dongle)
    
config SHIELD_SOFLE_LEFT
    def_bool $(shields_list_contains,sofle_left)

config SHIELD_SOFLE_RIGHT
    def_bool $(shields_list_contains,sofle_right)

config SHIELD_SOFLE_LEFT_PERIPHERAL
    def_bool $(shields_list_contains,sofle_left_peripheral)
```
